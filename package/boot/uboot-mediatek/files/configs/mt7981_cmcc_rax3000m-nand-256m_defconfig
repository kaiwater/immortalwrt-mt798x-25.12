## package/boot/uboot-mediatek/files/configs/mt7981_cmcc_rax3000m-nand-256m_defconfig
```kconfig
CONFIG_SYS_TEXT_BASE=0x4e000000
CONFIG_SYS_MALLOC_LEN=0x1000000
CONFIG_NR_DRAM_BANKS=1
CONFIG_DEFAULT_DEVICE_TREE="mt7981-cmcc-rax3000m-nand-256m"
CONFIG_DEFAULT_FDT_FILE="mt7981-cmcc-rax3000m-nand-256m"
CONFIG_DEFAULT_ENV_FILE="cmcc_rax3000m-nand-256m_env"
CONFIG_TARGET_MEDIATEK_MT7981=y
CONFIG_SYS_LOAD_ADDR=0x46000000
CONFIG_AUTOBOOT=y
CONFIG_AUTOBOOT_KEYED=y
CONFIG_AUTOBOOT_DELAY_STR="0"
CONFIG_AUTOBOOT_STOP_STR=" "
CONFIG_BOOTDELAY=0
CONFIG_BOARD_LATE_INIT_F=y
CONFIG_CMDLINE_TAG=y
CONFIG_SETUP_MEMORY_TAGS=y
CONFIG_INITRD_TAG=y
CONFIG_FIT=y
CONFIG_FIT_VERBOSE=y
CONFIG_FIT_BEST_MATCH=y
CONFIG_FIT_PRINT_FITTED_IMAGES=y
CONFIG_CONSOLE_MUX=y
CONFIG_SYS_CONSOLE_IS_IN_ENV=y
# CONFIG_DISPLAY_CPUINFO is not set
# CONFIG_DISPLAY_BOARDINFO is not set
CONFIG_ARCH_EARLY_INIT_R=y
CONFIG_SYS_INIT_ON_LOAD=y
CONFIG_MTDPARTS_DEFAULT="mtdparts=spi-nand0:1m(bl2),512k(u-boot-env),2m(factory),128m(firmware),-(ubi)"
CONFIG_ENV_OFFSET=0x100000
CONFIG_ENV_SIZE=0x80000
CONFIG_ENV_OVERWRITE=y
CONFIG_SYS_MMC_ENV_DEV=0
CONFIG_SYS_MMC_ENV_PART=2
CONFIG_ENV_FAT_DEVICE_AND_PART="2:1"
CONFIG_ENV_FAT_FILE="boot.env"
CONFIG_MMC=y
CONFIG_MMC_MTK=y
CONFIG_MMC_HS400_SUPPORT=y
CONFIG_MMC_HS400_ES_SUPPORT=y
CONFIG_PARTITIONS=y
CONFIG_MAC_PARTITION=y
CONFIG_EFI_PARTITION=y
CONFIG_DOS_PARTITION=y
CONFIG_ISO_PARTITION=y
CONFIG_AMIGA_PARTITION=y
CONFIG_LDO_REGULATOR_MT6358=y
CONFIG_REGULATOR=y
CONFIG_SYS_BOOTM_LEN=0x4000000
CONFIG_OF_BOARD_SETUP=y
CONFIG_OF_BOARD_FIXUP=y
CONFIG_SYS_BOOTM_LEN=0x4000000
CONFIG_PSTORE=y
CONFIG_CMD_PSTORE=y
CONFIG_PSTORE_RECORD_TYPE_CONSOLE=y
CONFIG_PSTORE_RECORD_TYPE_FTRACE=y
CONFIG_PSTORE_RECORD_TYPE_DMESG=y
CONFIG_PSTORE_RECORD_TYPE_PIC=y
CONFIG_BOOTM_VXWORKS=y
CONFIG_CMD_ELF=y
CONFIG_CMD_GO=y
CONFIG_CMD_RUN=y
CONFIG_CMD_BOOTM=y
CONFIG_CMD_BOOTD=y
CONFIG_SYS_CBSIZE=256
CONFIG_SYS_PBSIZE=276
CONFIG_SYS_MAXARGS=16
CONFIG_SYS_BARGSIZE=256
CONFIG_SYS_LONGHELP=y
CONFIG_AUTO_COMPLETE=y
CONFIG_SYS_HUSH_PARSER=y
CONFIG_SYS_PROMPT="uboot> "
CONFIG_CMDLINE_EDITING=y
CONFIG_CMDLINE_PS2="uboot> "
CONFIG_CMD_MTDPARTS=y
CONFIG_MTD=y
CONFIG_MTD_RAW_NAND=y
CONFIG_MTD_SPI_NAND=y
CONFIG_SPI_NAND_USE_PLANE_BITS=y
CONFIG_SPI_NAND_WINBOND=y
CONFIG_SPI_NAND_MACRONIX=y
CONFIG_SPI_NAND_MICRON=y
CONFIG_SPI_NAND_GIGADEVICE=y
CONFIG_MTD_UBI=y
CONFIG_MTD_UBI_FASTMAP=y
CONFIG_CMD_UBI=y
CONFIG_CMD_NAND=y
CONFIG_CMD_UBI=y
CONFIG_RBTREE=y
CONFIG_CMD_FAT=y
CONFIG_CMD_PART=y
CONFIG_CMD_GETTIME=y
CONFIG_CMD_TIMER=y
CONFIG_CMD_GPIO=y
CONFIG_CMD_MTD=y
CONFIG_CMD_SF=y
CONFIG_CMD_SPI=y
CONFIG_CMD_I2C=y
CONFIG_CMD_LOADB=y
CONFIG_CMD_LOADS=y
CONFIG_CMD_SAVES=y
CONFIG_CMD_MEMORY=y
CONFIG_CMD_CRC32=y
CONFIG_CMD_ECHO=y
CONFIG_CMD_ITEST=y
CONFIG_CMD_SOURCE=y
CONFIG_CMD_SETEXPR=y
CONFIG_CMD_SLEEP=y
CONFIG_CMD_STRINGS=y
CONFIG_CMD_TIME=y
CONFIG_CMD_CACHE=y
CONFIG_CMD_REGULATOR=y
CONFIG_CMD_PSTORE=y
CONFIG_NET=y
CONFIG_NETCONSOLE=y
CONFIG_CMD_NET=y
CONFIG_CMD_NFS=y
CONFIG_CMD_DHCP=y
CONFIG_CMD_TFTPPUT=y
CONFIG_CMD_TFTPSRV=y
CONFIG_BOOTP_BOOTFILESIZE=y
CONFIG_BOOTP_SEND_HOSTNAME=y
CONFIG_BOOTP_NTPSERVER=y
CONFIG_BOOTP_PXE=y
CONFIG_BOOTP_PXE_CLIENTARCH=0x100
CONFIG_BOOTP_VCI_STRING="U-Boot.armv8"
CONFIG_CMD_MD5SUM=y
CONFIG_MD5SUM_VERIFY=y
CONFIG_CMD_HASH=y
CONFIG_HASH_VERIFY=y
CONFIG_CMD_RARP=y
CONFIG_CMD_PING=y
CONFIG_CMD_CDP=y
CONFIG_CMD_SNTP=y
CONFIG_CMD_DNS=y
CONFIG_CMD_LINK_LOCAL=y
CONFIG_CMD_MAC=y
CONFIG_CMD_CONFIG=y
CONFIG_CMD_DHCP_PXE=y
CONFIG_SPI=y
CONFIG_DM_SPI=y
CONFIG_MTK_SPIM=y
CONFIG_SPI_FLASH=y
CONFIG_SPI_FLASH_GIGA=y
CONFIG_SPI_FLASH_INTEL=y
CONFIG_SPI_FLASH_MACRONIX=y
CONFIG_SPI_FLASH_ATMEL=y
CONFIG_SPI_FLASH_SPANSION=y
CONFIG_SPI_FLASH_STMICRO=y
CONFIG_SPI_FLASH_SST=y
CONFIG_SPI_FLASH_WINBOND=y
CONFIG_SPI_FLASH_XMC=y
CONFIG_SPI_FLASH_MTD=y
CONFIG_DM_ETH=y
CONFIG_DM_MDIO=y
CONFIG_DM_MDIO_MUX=y
CONFIG_MEDIATEK_ETH=y
CONFIG_DM_GPIO=y
CONFIG_DM_SERIAL=y
CONFIG_SERIAL_RX_BUFFER=y
CONFIG_MTK_SERIAL=y
CONFIG_DM_REGULATOR=y
CONFIG_DM_REGULATOR_FIXED=y
CONFIG_DM_REGULATOR_GPIO=y
CONFIG_DM_PWM=y
CONFIG_PWM_MTK=y
CONFIG_RAM=y
CONFIG_SCSI=y
CONFIG_DM_SERIAL=y
CONFIG_SERIAL_RX_BUFFER=y
CONFIG_MTK_SERIAL=y
CONFIG_SPI=y
CONFIG_DM_SPI=y
CONFIG_MTK_SPIM=y
CONFIG_ZSTD=y
CONFIG_HEXDUMP=y
CONFIG_CMD_BOOTMENU=y
CONFIG_CMD_BOOTMENU_RETURN=y
```
